## drivers/media/pci/saa7231/Kconfig
```kconfig
config VIDEO_SAA7231
	tristate "SAA7231 PCI Express bridge based devices"
	depends on PCI && I2C
        select DVB_TDA18272 if MEDIA_SUBDRV_AUTOSELECT
        select DVB_A8290 if MEDIA_SUBDRV_AUTOSELECT
        select DVB_CXD2817 if MEDIA_SUBDRV_AUTOSELECT
        select DVB_CXD2861 if MEDIA_SUBDRV_AUTOSELECT
        select DVB_CXD2820R if MEDIA_SUBDRV_AUTOSELECT

	help
	  Support for PCI cards based on the SAA7231 PCI Express bridge.

	  Say Y if you own such a device and want to use it.
```

## old/v4l/Kconfig
```kconfig
mainmenu "V4L/DVB menu"
source Kconfig.kern
config VIDEO_KERNEL_VERSION
	bool "Enable drivers not supported by this kernel"
	default n
	---help---
	  Normally drivers that require a kernel newer 3.12.6,
	  the kernel you are compiling for now, will be disabled.

	  Turning this switch on will let you enabled them, but be warned
	  they may not work properly or even compile.

	  They may also work fine, and the only reason they are listed as
	  requiring a newer kernel is that no one has tested them with an
	  older one yet.

	  If the driver works, please post a report to the V4L mailing list:
			 linux-media@vger.kernel.org.

	  Unless you know what you are doing, you should answer N.
```
